## app/Kconfig
```kconfig
menu "Application settings"

config APP_HEARTBEAT_PERIOD_MS
    int "App led blink period (100-2000)"
    default 100
    range 100 2000

menuconfig LED_SUBSYSTEM
    bool "Led subsystem"
    default y

if LED_SUBSYSTEM

choice
    prompt "Led blink sleep time"
    default BLINK_SLEEP_1000MS

config BLINK_SLEEP_250MS
    bool"Fast (250ms)"
config BLINK_SLEEP_1000MS
    bool"Medium (1s)"
config BLINK_SLEEP_2000MS
    bool"Slow (2s)"

endchoice

config BLINK_SLEEP_TIME_MS
    int 
    default 250 if BLINK_SLEEP_250MS
    default 1000 if BLINK_SLEEP_1000MS
    default 2000 if BLINK_SLEEP_2000MS
    default 0

menuconfig ADVANCED_LED_SETTINGS
    bool "Advanced led settings"
    default y

if ADVANCED_LED_SETTINGS

config LED_BRIGHTNESS
    int "Led brightness (0-100)"
    default 100
    range 0 100

config LED_FADE_DURATION
    int "Led fade duration (ms)"
    default 500
    range 0 5000

endif

menu "Expert settings"
    visible if ADVANCED_LED_SETTINGS

config ENABLE_LED_DEBUGGIN
    bool "Enable led debuggin"

config CUSTOM_BLINK_PATTERN
    bool "Custom blink pattern"

endmenu

endif

endmenu

menu "Zephyr settings"

source"Kconfig.zephyr"

endmenu
```
